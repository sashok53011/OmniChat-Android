## esp32-p4-firmware/main/Kconfig.projbuild
```kconfig
menu "Wi-Fi Remote (fixed config)"
    config WIFI_RMT_STATIC_RX_BUFFER_NUM # ignore: multiple-definition
        int "Max number of WiFi static RX buffers"
        default 10
    config WIFI_RMT_DYNAMIC_RX_BUFFER_NUM # ignore: multiple-definition
        int "Max number of WiFi dynamic RX buffers"
        default 32
    choice WIFI_RMT_TX_BUFFER # ignore: multiple-definition
        prompt "Type of WiFi TX buffers"
        default WIFI_RMT_DYNAMIC_TX_BUFFER
        config WIFI_RMT_STATIC_TX_BUFFER # ignore: multiple-definition
            bool "Static"
        config WIFI_RMT_DYNAMIC_TX_BUFFER # ignore: multiple-definition
            bool "Dynamic"
    endchoice
    config WIFI_RMT_TX_BUFFER_TYPE # ignore: multiple-definition
        int
        default 0 if WIFI_RMT_STATIC_TX_BUFFER
        default 1 if WIFI_RMT_DYNAMIC_TX_BUFFER
    config WIFI_RMT_DYNAMIC_TX_BUFFER_NUM # ignore: multiple-definition
        int "Max number of WiFi dynamic TX buffers"
        depends on WIFI_RMT_DYNAMIC_TX_BUFFER
        default 32
    config WIFI_RMT_STATIC_TX_BUFFER_NUM # ignore: multiple-definition
        int "Max number of WiFi static TX buffers"
        depends on WIFI_RMT_STATIC_TX_BUFFER
        default 10
    config WIFI_RMT_CACHE_TX_BUFFER_NUM # ignore: multiple-definition
        int "Max number of cache TX buffers"
        default 0
    config WIFI_RMT_DYNAMIC_RX_MGMT_BUF # ignore: multiple-definition
        int "RX management buffer type"
        default 16
    config WIFI_RMT_ESPNOW_MAX_ENCRYPT_NUM # ignore: multiple-definition
        int "Maximum espnow encrypt peers number"
        default 0
    config WIFI_RMT_RX_MGMT_BUF_NUM_DEF # ignore: multiple-definition
        int "Default number of RX management buffers"
        default 5
endmenu
```

## esp32-p4-firmware/sdkconfig.defaults
```kconfig
CONFIG_IDF_TARGET="esp32p4"
CONFIG_SLAVE_IDF_TARGET_ESP32C6=y

# Flash / PSRAM
CONFIG_ESPTOOLPY_FLASHSIZE_32MB=y
CONFIG_ESPTOOLPY_FLASHMODE_QIO=y
CONFIG_SPIRAM=y
CONFIG_SPIRAM_SPEED_200M=y
CONFIG_SPIRAM_XIP_FROM_PSRAM=y
CONFIG_CACHE_L2_CACHE_256KB=y
CONFIG_CACHE_L2_CACHE_LINE_128B=y

# Partition table
CONFIG_PARTITION_TABLE_CUSTOM=y
CONFIG_PARTITION_TABLE_CUSTOM_FILENAME="partitions.csv"
CONFIG_PARTITION_TABLE_OFFSET=0x10000

# RTOS / tasks
CONFIG_FREERTOS_HZ=1000
CONFIG_ESP_MAIN_TASK_STACK_SIZE=10240
# CPU diagnostics: per-task run-time stats (uxTaskGetSystemState / vTaskGetRunTimeStats)
CONFIG_FREERTOS_GENERATE_RUN_TIME_STATS=y
CONFIG_FREERTOS_USE_TRACE_FACILITY=y
CONFIG_FREERTOS_USE_STATS_FORMATTING_FUNCTIONS=y

# LVGL (on FreeRTOS)
CONFIG_LV_OS_FREERTOS=y
CONFIG_LV_DEF_REFR_PERIOD=15
CONFIG_LV_USE_PERF_MONITOR=y
CONFIG_LV_USE_SYSMON=y
CONFIG_LV_USE_CLIB_MALLOC=y
CONFIG_LV_USE_CLIB_STRING=y
CONFIG_LV_USE_CLIB_SPRINTF=y
CONFIG_LV_DRAW_SW_DRAW_UNIT_CNT=2
CONFIG_ESP_LVGL_ADAPTER_ENABLE_FPS_STATS=y
CONFIG_LV_USE_FONT_COMPRESSED=y
CONFIG_LV_FONT_MONTSERRAT_14=y
CONFIG_LV_FONT_MONTSERRAT_16=y
CONFIG_LV_FONT_MONTSERRAT_18=y
CONFIG_LV_FONT_MONTSERRAT_20=y
CONFIG_LV_FONT_MONTSERRAT_22=y
CONFIG_LV_FONT_MONTSERRAT_24=y
CONFIG_LV_FONT_MONTSERRAT_26=y

# HTTP client (HTTPS for opencode.ai / ollama / fishtts)
CONFIG_ESP_HTTP_CLIENT_ENABLE_HTTPS=y

# WiFi
CONFIG_ESP_WIFI_ENABLED=y
CONFIG_ESP_WIFI_SOFTAP_SUPPORT=n
CONFIG_ESP_WIFI_STATIC_RX_BUFFER_NUM=10
CONFIG_ESP_WIFI_DYNAMIC_RX_BUFFER_NUM=32
CONFIG_ESP_WIFI_TX_BUFFER_TYPE=2
CONFIG_ESP_WIFI_DYNAMIC_TX_BUFFER_NUM=32
CONFIG_ESP_WIFI_DYNAMIC_RX_MGMT_BUF=16
CONFIG_ESP_WIFI_ESPNOW_MAX_ENCRYPT_NUM=0

# WiFi Remote (P4 has no on-chip WiFi; routed to external C6)
CONFIG_WIFI_RMT_STATIC_RX_BUFFER_NUM=10
CONFIG_WIFI_RMT_DYNAMIC_RX_BUFFER_NUM=32
CONFIG_WIFI_RMT_TX_BUFFER_TYPE=2
CONFIG_WIFI_RMT_DYNAMIC_TX_BUFFER_NUM=32
CONFIG_WIFI_RMT_DYNAMIC_RX_MGMT_BUF=16
CONFIG_WIFI_RMT_ESPNOW_MAX_ENCRYPT_NUM=0
CONFIG_WIFI_RMT_STATIC_TX_BUFFER_NUM=10
CONFIG_WIFI_RMT_CACHE_TX_BUFFER_NUM=0
CONFIG_WIFI_RMT_RX_MGMT_BUF_NUM_DEF=5

# ESP-Hosted (WiFi transport to external ESP32-C6 via SDIO)
CONFIG_ESP_HOSTED=y
CONFIG_ESP_HOSTED_HOST=y
CONFIG_ESP_HOSTED_AUTO_CALL_INIT_BEFORE_APP_MAIN=y
CONFIG_ESP_HOSTED_HOST_TYPE_MCU=y
CONFIG_ESP_HOSTED_CP_TARGET_ESP32C6=y
CONFIG_ESP_HOSTED_IDF_SLAVE_TARGET="esp32c6"
CONFIG_ESP_HOSTED_HOST_TRANSPORT_MCU=y
CONFIG_ESP_HOSTED_HOST_TRANSPORT_BUS_SDIO=y
CONFIG_ESP_HOSTED_SDIO_SLOT_1=y
CONFIG_ESP_HOSTED_HOST_SDIO_SLOT=1
CONFIG_ESP_HOSTED_HOST_SDIO_CLK_KHZ=40000
CONFIG_ESP_HOSTED_HOST_SDIO_BUS_WIDTH_4=y
CONFIG_ESP_HOSTED_HOST_SDIO_BUS_WIDTH=4
CONFIG_ESP_HOSTED_SDIO_CMD_GPIO_RANGE_MIN=0
CONFIG_ESP_HOSTED_SDIO_CMD_GPIO_RANGE_MAX=100
CONFIG_ESP_HOSTED_SDIO_CLK_GPIO_RANGE_MIN=0
CONFIG_ESP_HOSTED_SDIO_CLK_GPIO_RANGE_MAX=100
CONFIG_ESP_HOSTED_SDIO_D0_GPIO_RANGE_MIN=0
CONFIG_ESP_HOSTED_SDIO_D0_GPIO_RANGE_MAX=100
CONFIG_ESP_HOSTED_SDIO_D1_GPIO_RANGE_MIN=0
CONFIG_ESP_HOSTED_SDIO_D1_GPIO_RANGE_MAX=100
CONFIG_ESP_HOSTED_SDIO_D2_GPIO_RANGE_MIN=0
CONFIG_ESP_HOSTED_SDIO_D2_GPIO_RANGE_MAX=100
CONFIG_ESP_HOSTED_SDIO_D3_GPIO_RANGE_MIN=0
CONFIG_ESP_HOSTED_SDIO_D3_GPIO_RANGE_MAX=100
CONFIG_ESP_HOSTED_HOST_SDIO_PIN_CMD=19
CONFIG_ESP_HOSTED_HOST_SDIO_PIN_CLK=18
CONFIG_ESP_HOSTED_HOST_SDIO_PIN_D0=14
CONFIG_ESP_HOSTED_HOST_SDIO_PIN_D1=15
CONFIG_ESP_HOSTED_HOST_SDIO_PIN_D2=16
CONFIG_ESP_HOSTED_HOST_SDIO_PIN_D3=17
CONFIG_ESP_HOSTED_HOST_RESET_GPIO=54
CONFIG_ESP_HOSTED_HOST_RESET_ACTIVE_LOW=y
CONFIG_ESP_HOSTED_HOST_FEAT_WIFI=y
CONFIG_ESP_HOSTED_HOST_FEAT_WIFI_READY=y

# WiFi Remote
CONFIG_ESP_WIFI_REMOTE_ENABLED=y
CONFIG_ESP_WIFI_REMOTE_LIBRARY_HOSTED=y
CONFIG_ESP_HOSTED_PRIV_ENABLE_WIFI_OPTIONS=y
CONFIG_ESP_HOSTED_PRIV_ENABLE_WIFI_OPTIONS=y
CONFIG_WIFI_RMT_STATIC_RX_BUFFER_NUM=10
CONFIG_WIFI_RMT_DYNAMIC_RX_BUFFER_NUM=32
CONFIG_WIFI_RMT_TX_BUFFER_TYPE=2
CONFIG_WIFI_RMT_DYNAMIC_TX_BUFFER_NUM=32
CONFIG_WIFI_RMT_DYNAMIC_RX_MGMT_BUF=16
CONFIG_WIFI_RMT_ESPNOW_MAX_ENCRYPT_NUM=0
CONFIG_WIFI_RMT_STATIC_TX_BUFFER_NUM=10
CONFIG_WIFI_RMT_CACHE_TX_BUFFER_NUM=0
CONFIG_WIFI_RMT_RX_MGMT_BUF_NUM_DEF=5

# Compiler
CONFIG_COMPILER_OPTIMIZATION_PERF=y
# IPv4-only networking: the ESP-Hosted / WiFi-remote stack cannot reliably
# connect to IPv6 (AAAA) hosts, which breaks HTTPS to opencode.ai / fishtts.
CONFIG_LWIP_IPV6=n
CONFIG_LWIP_DNS_MAX_HOST_IP=3
# Reduce TLS heap: dynamic TX/RX buffers avoid ALLOC_FAILED with the full CA bundle.
CONFIG_MBEDTLS_DYNAMIC_BUFFER=y
CONFIG_MBEDTLS_SSL_IN_CONTENT_LEN=8192
# This ESP32-P4 is silicon revision v1.x; target the older revision.
CONFIG_ESP32P4_SELECTS_REV_LESS_V3=y

# BSP SD card (uSD over SDMMC slot 0; format FAT if mount fails)
CONFIG_BSP_SD_FORMAT_ON_MOUNT_FAIL=y
CONFIG_BSP_SD_MOUNT_POINT="/sdcard"
```
